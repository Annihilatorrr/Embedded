/*
 * ledmatrixmax7219.cpp
 *
 *  Created on: 30 дек. 2020 г.
 *      Author: rusla
 */

#include "ledmatrixmax7219.h"

struct Character
{
	int width{};
	int columns[8]{};
};

Character characters[] =
{
		{0, {0, 0, 0, 0, 0, 0, 0, 0}},  // 0 - 'Empty Cell'
				{5, {0x3e, 0x5b, 0x4f, 0x5b, 0x3e, 0, 0, 0}}, // 1 - 'Sad Smiley'
				{5, {0x3e, 0x6b, 0x4f, 0x6b, 0x3e, 0, 0, 0}},  // 2 - 'Happy Smiley'
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				{8, {0xff, 0xff, 0xff, 0xff, 0xff, 0xff, 0xff, 0xff}}  // Full fill
};

void delay();
uint8_t CH[] = {
		0, 0, 0, 0, 0, 0, 0, 0,  // 0 - 'Empty Cell'
		5, 0x3e, 0x5b, 0x4f, 0x5b, 0x3e, 0, 0,  // 1 - 'Sad Smiley'
		5, 0x3e, 0x6b, 0x4f, 0x6b, 0x3e, 0, 0,  // 2 - 'Happy Smiley'
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		5, 0x02, 0x01, 0x02, 0x04, 0x02, 0, 0,  // 126 - '~'
};

LedMatrixMax7219::LedMatrixMax7219(int rows, int columns, int matrixSize):m_rows(rows), m_columns(columns), m_matrixSize(matrixSize)
{
	// TODO Auto-generated constructor stub

}

void LedMatrixMax7219::sendCommand(uint8_t address, uint8_t command)
{
	GPIOA->ODR &= ~GPIO_ODR_ODR_4;
	for (int i=0;i<m_columns; i++)
	{
		sendByte(address);
		sendByte(command);
	}
	GPIOA->ODR &= ~GPIO_ODR_ODR_4;
	GPIOA->ODR |= GPIO_ODR_ODR_4;
}

void LedMatrixMax7219::setled(uint8_t row, uint8_t col, uint8_t value)
{
	bitWrite(buffer[col], row, value);

	int n = col >> 3;
	int c = col % 8;
	GPIOA->ODR &= ~GPIO_ODR_ODR_4;
	for (int i=0; i<m_columns; i++)
	{
		if (i == (m_columns-(n+1)))
		{
			sendByte (((c+1)));
			sendByte (buffer[col]);
		}
		else
		{
			sendByte (0);
			sendByte (0);
		}
	}
	GPIOA->ODR &= ~GPIO_ODR_ODR_4;
	GPIOA->ODR |= GPIO_ODR_ODR_4;
}

void LedMatrixMax7219::maxInit(uint8_t brightness)
{
	sendCommand(0x09, 0x00);       //  no decoding
	sendCommand(0x0b, 0x07);       //  scan limit = 8 LEDs
	sendCommand(0x0c, 0x01);       //  power down =0,normal mode = 1
	sendCommand(0x0f, 0x00);       //  no test display

	maxClear ();

	sendCommand(0x0a, brightness);       //  brightness intensity
	//writeChar(127, 1);
	//shiftLeft();
	//shiftChar(127, 1, 'L');
	//drawSmile('2', 0);
	const char* str{"Happy New Year!!!  ** 2021"};
	scrollString((uint8_t*)str, 1, 'L');


}

void LedMatrixMax7219::drawSmile (char c, uint8_t matrixIndex)
{
	int width = characters[c].width;
	int start= (c<<3)+1;
	int startColumnIndex = 7; // aligned left
	for (int j = 0; j < 7; j++)
	{
		setColumn (startColumnIndex + ((matrixIndex)<<3), characters[c].columns[j]);
		--startColumnIndex;
	}
}
void LedMatrixMax7219::writeChar (char c, uint8_t matrixIndex)
{
	int width = characters[c].width;
	int start= (c<<3)+1;
	int startColumnIndex = 7; // aligned left
	for (int j = 0; j < width; j++)
	{
		setColumn (startColumnIndex + ((matrixIndex)<<3), characters[c].columns[j]);
		--startColumnIndex;
	}
}
void LedMatrixMax7219::setColumn(uint8_t columnIndexInDisplay, uint8_t value)
{
	int matrixIndex = columnIndexInDisplay >> 3;
	int columnIndexInMatrix = columnIndexInDisplay % 8;

	int matrixRightMostColumnIndex = matrixIndex<<3;

	uint8_t store = value;
	for (int i = 0; i < m_columns; ++i)
	{
		if (i != matrixIndex)
		{
			sendByte(0);
			sendByte(0);
		}
		else
		{
			//for (int col=0+(8*n); col<8+(8*n); col++)  // uncomment this if the character looks inverted about X axis
			for (int col = 7 + matrixRightMostColumnIndex; col >= matrixRightMostColumnIndex; --col)
			{
				bool b = value&0x80;
				setled (columnIndexInMatrix, col, b);
				value<<=1;
			}
		}
	}
	buffer_row[columnIndexInDisplay] = store;
}

void LedMatrixMax7219::maxClear()
{
	int lastIndexOfDisplayColumn = (m_columns << 3) - 1;
	for (int i = 0; i <= lastIndexOfDisplayColumn; i++)
	{
		setColumn(i, 0);
	}
	for (int i = 0; i < 80; ++i)
	{
		buffer[i] = 0;
		buffer_row[i] = 0;
	}
}

void LedMatrixMax7219::shiftLeft()
{
	int lastIndexOfDisplayColumn = (m_columns << 3) - 1;
	uint8_t old = buffer_row[lastIndexOfDisplayColumn];
	for (int i = 0; i <= lastIndexOfDisplayColumn; ++i)
	{
		setColumn(i, buffer_row[i]);
	}
	for (int i = 79; i > 0; --i)
	{
		buffer_row[i] = buffer_row[i-1];
	}

	buffer_row[0] = old;
}


void LedMatrixMax7219::shiftRight()
{
	int lastIndexOfDisplayColumn = (m_columns << 3) - 1;
	uint8_t old = buffer_row[0];

	for (int i = lastIndexOfDisplayColumn; i >= 0; --i)
	{
		setColumn (i, buffer_row[i]);
	}

	for (int i = 0; i < 80; ++i)
	{
		buffer_row[i] = buffer_row[i+1];
	}

	buffer_row[lastIndexOfDisplayColumn] = old;
}

void LedMatrixMax7219::shiftChar (char c, uint32_t speed, char direction)
{
	int width = characters[c].width;
	int lastIndexOfDisplayColumn = (m_columns << 3) - 1;

	switch (direction)
	{
	case ('L') :
		for (int j = 0; j <= width; j++)
		{
			setColumn (0, characters[c].columns[j]);
			shiftLeft();
			//delay();
		}
	break;

	case ('R') :
		for (int j = width; j >= 0; j--)
		{
			setColumn (lastIndexOfDisplayColumn, characters[c].columns[j]);
			shiftRight();
			//delay();
		}
	break;

	default :
		break;
	}
}



void LedMatrixMax7219::scrollString (uint8_t *string, uint32_t speed, char direction)
{
	while (*string != 0)
	{
		shiftChar (*string, speed, direction);
		string++;
	}
}
