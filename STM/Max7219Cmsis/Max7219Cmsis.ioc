# file: Max7219Cmsis.ioc
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Mcu.Family=STM32F4
Mcu.Name=STM32F401R(D-E)Tx
Mcu.Package=LQFP64
NVIC.PriorityGroup=NVIC_PRIORITYGROUP_4
NVIC.RCC_IRQn=true\:0\:0\:false\:false\:true\:true\:false
PA13.Mode=Serial_Wire
PA13.Signal=SYS_JTMS-SWDIO
PA14.Mode=Serial_Wire
PA14.Signal=SYS_JTCK-SWCLK
PH0\ -\ OSC_IN.Mode=HSE-External-Oscillator
PH0\ -\ OSC_IN.Signal=RCC_OSC_IN
PH1\ -\ OSC_OUT.Mode=HSE-External-Oscillator
PH1\ -\ OSC_OUT.Signal=RCC_OSC_OUT
ProjectManager.HeapSize=0x200
ProjectManager.StackSize=0x400
ProjectManager.TargetToolchain=STM32CubeIDE
RCC.AHBFreq_Value=16000000
RCC.APB1Freq_Value=16000000
RCC.APB2Freq_Value=16000000
RCC.CortexFreq_Value=16000000
RCC.HSE_VALUE=25000000
RCC.HSI_VALUE=16000000
RCC.LSE_VALUE=32768
RCC.SYSCLKFreq_VALUE=16000000
RCC.VCOOutputFreq_Value=192000000
board=custom

// file: Core/Src/main.cpp
/* USER CODE BEGIN Header */
/**
 ******************************************************************************
 * @file           : main.c
 * @brief          : Main program body
 ******************************************************************************
 * @attention
 *
 * <h2><center>&copy; Copyright (c) 2020 STMicroelectronics.
 * All rights reserved.</center></h2>
 *
 * This software component is licensed by ST under BSD 3-Clause license,
 * the "License"; You may not use this file except in compliance with the
 * License. You may obtain a copy of the License at:
 *                        opensource.org/licenses/BSD-3-Clause
 *
 ******************************************************************************
 */
/* USER CODE END Header */

#include "main.h"

/* USER CODE BEGIN Includes */
#include "application.h"
/* USER CODE END Includes */

/* USER CODE BEGIN PV */

volatile uint32_t msTicks = 0;                              /* Variable to store millisecond ticks */

void SysTick_Handler(void)
{                               /* SysTick interrupt Handler. */
	msTicks++;                                                /* See startup file startup_LPC17xx.s for SysTick vector */
}

/* USER CODE END PV */

void SystemClock_Config(void);
static void MX_GPIO_Init(void);

/* USER CODE BEGIN 0 */

void initTimer()
{
	// Basic Timer configuration
	RCC->APB1ENR |= RCC_APB1ENR_TIM2EN;         // Enable timer 2 clock
	TIM2->CR1    &= ~TIM_CR1_CEN;               // Disable counter
	TIM2->CR2    &= ~TIM_CR2_TI1S;              // TI1 only

	TIM2->PSC     = 1000;         // 10000*100s = 1s
	TIM2->CR1    &= ~TIM_CR1_DIR;               // Up direction

	// Capture 2
	GPIOA->MODER  |=  GPIO_MODE_AF_PP << 2;     // Alternate function on pin 1
	GPIOA->AFR[0] |=  GPIO_AF1_TIM2 << 4;
	TIM2->CCMR1   |=  TIM_CCMR1_CC2S_0;         // Set capture channel 2 as input on TI2 (CC2S = 01)
	TIM2->CCER    &= ~TIM_CCER_CC2P;            // Set capture on rising edge event
	TIM2->CCER    &= ~TIM_CCER_CC2NP;
	TIM2->CCER    |=  TIM_CCER_CC2E;            // Enable capture on channel 1
	TIM2->DIER    |=  TIM_DIER_CC2IE;           // Enable interrupt on capture channel 1

	// Timer start and IRQ enable
	TIM2->DIER |= TIM_DIER_UIE;                 // Enable Update interrupt
	NVIC_EnableIRQ( TIM2_IRQn );                // Vector name with my startup is TIM2_IRQHandler()
	TIM2->CR1 |= TIM_CR1_CEN;                   // Faster Pussycat Kill! Kill!

}

/* USER CODE END 0 */

int main(void)
{

	/* MCU Configuration--------------------------------------------------------*/

	/* Reset of all peripherals, Initializes the Flash interface and the Systick. */
	HAL_Init();

	/* USER CODE BEGIN Init */
	initTimer();
	/* USER CODE END Init */

	/* Configure the system clock */
	//SystemClock_Config();

	/* Initialize all configured peripherals */
	MX_GPIO_Init();
	/* USER CODE BEGIN 2 */
	Application app;
	app.start();
	/* USER CODE END 2 */

	/* Infinite loop */
	while (1)
	{

	}
}

void SystemClock_Config(void)
{
	RCC_OscInitTypeDef RCC_OscInitStruct = {0};
	RCC_ClkInitTypeDef RCC_ClkInitStruct = {0};

	/** Configure the main internal regulator output voltage
	 */
	__HAL_RCC_PWR_CLK_ENABLE();
	__HAL_PWR_VOLTAGESCALING_CONFIG(PWR_REGULATOR_VOLTAGE_SCALE2);
	/** Initializes the CPU, AHB and APB busses clocks
	 */
	RCC_OscInitStruct.OscillatorType = RCC_OSCILLATORTYPE_HSI;
	RCC_OscInitStruct.HSIState = RCC_HSI_ON;
	RCC_OscInitStruct.HSICalibrationValue = RCC_HSICALIBRATION_DEFAULT;
	RCC_OscInitStruct.PLL.PLLState = RCC_PLL_NONE;
	if (HAL_RCC_OscConfig(&RCC_OscInitStruct) != HAL_OK)
	{
		Error_Handler();
	}
	/** Initializes the CPU, AHB and APB busses clocks
	 */
	RCC_ClkInitStruct.ClockType = RCC_CLOCKTYPE_HCLK|RCC_CLOCKTYPE_SYSCLK
			|RCC_CLOCKTYPE_PCLK1|RCC_CLOCKTYPE_PCLK2;
	RCC_ClkInitStruct.SYSCLKSource = RCC_SYSCLKSOURCE_HSI;
	RCC_ClkInitStruct.AHBCLKDivider = RCC_SYSCLK_DIV1;
	RCC_ClkInitStruct.APB1CLKDivider = RCC_HCLK_DIV1;
	RCC_ClkInitStruct.APB2CLKDivider = RCC_HCLK_DIV1;

	if (HAL_RCC_ClockConfig(&RCC_ClkInitStruct, FLASH_LATENCY_0) != HAL_OK)
	{
		Error_Handler();
	}

	HAL_SYSTICK_Config( HAL_RCC_GetHCLKFreq() / 1000 );
	HAL_SYSTICK_CLKSourceConfig( SYSTICK_CLKSOURCE_HCLK );

	/* SysTick_IRQn interrupt configuration */
	HAL_NVIC_SetPriority( SysTick_IRQn, 0, 0 );
}

static void MX_GPIO_Init(void)
{

	/* GPIO Ports Clock Enable */
	//__HAL_RCC_GPIOH_CLK_ENABLE();
	//__HAL_RCC_GPIOA_CLK_ENABLE();

}

void TIM2_IRQHandler(void) {

	//Is the timer set?
	if(TIM2->SR & TIM_SR_UIF) {

		//Draw a rectangle on screen (test purpose).

		//Clears flag.
		TIM2->SR &= ~TIM_SR_UIF;
	}
}

void Error_Handler(void)
{
}

/************************ (C) COPYRIGHT STMicroelectronics *****END OF FILE****/
